## arch/arm64/configs/teres_i.defconfig
```kconfig
CONFIG_ARCH_SUNXI=y
CONFIG_RTL8723BS=m # WiFi/BLE
CONFIG_DRM_ANALOGIX_ANX6345=m # Display
CONFIG_AXP20X_BATTERY=m # Battery gauge
```

## drivers/net/wireless/realtek/rtl8821CU/Kconfig
```kconfig
config RTL8821CU
	tristate "Realtek 8821C USB WiFi"
	depends on MAC80211 && USB
	help
	  This is an alternative driver for various Realtek RTL8821C
```
