// SPDX-License-Identifier: (GPL-2.0+ OR MIT)
/*
 * Copyright (C) 2019 OLIMEX Ltd.
 *
 */

/dts-v1/;

#include "sun50i-a64-olinuxino-1Ge4GW.dts"

/ {
	model = "Olimex A64-Olinuxino-1Ge16GW";
	compatible = "olimex,a64-olinuxino-1ge16gw", "allwinner,sun50i-a64";
};

&mmc2 {
	vqmmc-supply = <&reg_eldo1>;
	mmc-hs200-1_8v;
	allwinner,drive-data-phase = <180>;
};
